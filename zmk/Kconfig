## zmk/Kconfig
```kconfig
rsource "drivers/usb/Kconfig"
rsource "drivers/bluetooth/Kconfig"
rsource "drivers/sensor/Kconfig"
rsource "drivers/watchdog/Kconfig"
rsource "drivers/led_strip/Kconfig"

config BOOT_DIAG
	bool "Boot diagnostic (.noinit SRAM buffer for SWS debug)"
	default n
	help
	  Records boot stage codes to a .noinit SRAM buffer that can be read
	  via SWS/BDT even when USB is not working.

config BOOT_DIAG_GPIO
	bool "Boot diagnostic GPIO heartbeat (PD7)"
	default y
	depends on BOOT_DIAG
	help
	  Toggle PD7 at each boot stage for logic analyzer visibility.

config FLASH_MGMT
	bool "Raw flash management via mcumgr"
	default n
	depends on MCUMGR && FLASH
	help
	  Adds a custom mcumgr group (ID 64) with raw flash erase/write/read
	  commands. Used to restore original firmware via USB without SWS
	  hardware.

config RAINY_RGB
	bool "Crush 80 out-of-tree RGB lighting engine"
	depends on LED_STRIP_B91_SPI
	help
	  Custom WS2812 lighting engine (effects, reactivity, per-key) that
	  replaces ZMK's rgb_underglow.

config RAINY_RGB_IDLE_BLANK
	bool "Blank RGB when keyboard is idle"
	default n
	depends on RAINY_RGB
	help
	  Turns off RGB when activity state changes to idle.
```
